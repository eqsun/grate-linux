## arch/arm/configs/surface-rt_defconfig
```kconfig
CONFIG_SYSVIPC=y
CONFIG_NO_HZ=y
CONFIG_HIGH_RES_TIMERS=y
CONFIG_PREEMPT=y
CONFIG_IKCONFIG=y
CONFIG_IKCONFIG_PROC=y
CONFIG_CGROUPS=y
CONFIG_CGROUP_SCHED=y
CONFIG_RT_GROUP_SCHED=y
CONFIG_CGROUP_FREEZER=y
CONFIG_CGROUP_CPUACCT=y
CONFIG_CGROUP_DEBUG=y
CONFIG_NAMESPACES=y
CONFIG_USER_NS=y
CONFIG_BLK_DEV_INITRD=y
CONFIG_ELF_CORE=n
CONFIG_EMBEDDED=y
CONFIG_PERF_EVENTS=y
CONFIG_SLAB=y
CONFIG_ARCH_TEGRA=y
CONFIG_PL310_ERRATA_727915=y
CONFIG_ARM_ERRATA_720789=y
CONFIG_ARM_ERRATA_754327=y
CONFIG_ARM_ERRATA_798181=y
CONFIG_SMP=y
CONFIG_HAVE_ARM_ARCH_TIMER=y
CONFIG_HIGHMEM=y
CONFIG_ARM_APPENDED_DTB=y
CONFIG_ARM_ATAG_DTB_COMPAT=y
CONFIG_KEXEC=y
CONFIG_EFI=y
CONFIG_DMI=n
CONFIG_CPU_FREQ=y
CONFIG_CPU_FREQ_DEFAULT_GOV_ONDEMAND=y
CONFIG_CPU_FREQ_GOV_USERSPACE=y
CONFIG_CPUFREQ_DT=y
CONFIG_CPU_IDLE=y
CONFIG_ARM_TEGRA_CPUIDLE=y
CONFIG_VFP=y
CONFIG_NEON=y
CONFIG_MODULES=y
CONFIG_MODULE_UNLOAD=y
CONFIG_MODULE_FORCE_UNLOAD=y
CONFIG_BLOCK_LEGACY_AUTOLOAD=n
CONFIG_PARTITION_ADVANCED=y
CONFIG_CMA=y
CONFIG_NET=y
CONFIG_PACKET=y
CONFIG_UNIX=y
CONFIG_NET_KEY=y
CONFIG_INET=y
CONFIG_IP_PNP=y
CONFIG_IP_PNP_DHCP=y
CONFIG_IP_PNP_BOOTP=y
CONFIG_IP_PNP_RARP=y
CONFIG_INET_ESP=y
CONFIG_INET_DIAG=n
CONFIG_IPV6_ROUTER_PREF=y
CONFIG_IPV6_OPTIMISTIC_DAD=y
CONFIG_INET6_AH=y
CONFIG_INET6_ESP=y
CONFIG_INET6_IPCOMP=y
CONFIG_IPV6_MIP6=y
CONFIG_IPV6_TUNNEL=y
CONFIG_IPV6_MULTIPLE_TABLES=y
CONFIG_CAN=y
CONFIG_CAN_MCP251X=y
CONFIG_BT=y
CONFIG_BT_RFCOMM=y
CONFIG_BT_BNEP=y
CONFIG_BT_HIDP=y
CONFIG_BT_HCIUART=y
CONFIG_BT_HCIUART_BCM=y
CONFIG_CFG80211=y
CONFIG_MAC80211=y
CONFIG_RFKILL=y
CONFIG_RFKILL_INPUT=y
CONFIG_RFKILL_GPIO=y
CONFIG_NFC=y
CONFIG_NFC_HCI=y
CONFIG_NFC_SHDLC=y
CONFIG_NFC_PN544_I2C=y
CONFIG_DEVTMPFS=y
CONFIG_DEVTMPFS_MOUNT=y
CONFIG_TEGRA_GMI=y
CONFIG_TRUSTED_FOUNDATIONS=y
CONFIG_EFI_GENERIC_STUB_INITRD_CMDLINE_LOADER=y
CONFIG_MTD=y
CONFIG_MTD_SPI_NOR=y
CONFIG_BLK_DEV_LOOP=y
CONFIG_ASUS_DOCKRAM=y
CONFIG_EEPROM_AT24=y
CONFIG_SCSI=y
CONFIG_BLK_DEV_SD=y
CONFIG_BLK_DEV_SR=y
CONFIG_BLK_DEV_BSG=n
CONFIG_SCSI_LOWLEVEL=n
CONFIG_NETDEVICES=y
CONFIG_DUMMY=y
CONFIG_ETHERNET=n
CONFIG_USB_NET_DRIVERS=n
CONFIG_WLAN_VENDOR_ADMTEK=n
CONFIG_WLAN_VENDOR_ATH=n
CONFIG_WLAN_VENDOR_ATMEL=n
CONFIG_WLAN_VENDOR_BROADCOM=n
CONFIG_WLAN_VENDOR_CISCO=n
CONFIG_WLAN_VENDOR_INTEL=n
CONFIG_WLAN_VENDOR_INTERSIL=n
CONFIG_MWIFIEX=m
CONFIG_MWIFIEX_SDIO=m
CONFIG_WLAN_VENDOR_MEDIATEK=n
CONFIG_WLAN_VENDOR_MICROCHIP=n
CONFIG_WLAN_VENDOR_RALINK=n
CONFIG_WLAN_VENDOR_REALTEK=n
CONFIG_WLAN_VENDOR_RSI=n
CONFIG_WLAN_VENDOR_ST=n
CONFIG_WLAN_VENDOR_TI=n
CONFIG_WLAN_VENDOR_ZYDAS=n
CONFIG_WLAN_VENDOR_QUANTENNA=n
CONFIG_INPUT_JOYDEV=y
CONFIG_INPUT_EVDEV=y
CONFIG_KEYBOARD_GPIO=y
CONFIG_KEYBOARD_TEGRA=y
CONFIG_KEYBOARD_CAP11XX=y
CONFIG_INPUT_TOUCHSCREEN=y
CONFIG_TOUCHSCREEN_ATMEL_MXT=y
CONFIG_TOUCHSCREEN_WM97XX=y
CONFIG_TOUCHSCREEN_WM9705=n
CONFIG_TOUCHSCREEN_WM9713=n
CONFIG_INPUT_MISC=y
CONFIG_INPUT_GPIO_VIBRA=y
CONFIG_LEGACY_PTYS=n
CONFIG_SERIAL_8250=y
CONFIG_SERIAL_8250_CONSOLE=y
CONFIG_SERIAL_OF_PLATFORM=y
CONFIG_SERIAL_TEGRA=y
CONFIG_SERIAL_DEV_BUS=y
CONFIG_HW_RANDOM=n
CONFIG_I2C_COMPAT=n
CONFIG_I2C_CHARDEV=y
CONFIG_I2C_MUX=y
CONFIG_I2C_MUX_GPIO=y
CONFIG_I2C_MUX_PCA954x=y
CONFIG_I2C_MUX_PINCTRL=y
CONFIG_I2C_TEGRA=y
CONFIG_I2C_HOTPLUG_GPIO=y
CONFIG_SPI=y
CONFIG_SPI_TEGRA114=y
CONFIG_SPI_TEGRA20_SFLASH=y
CONFIG_SPI_TEGRA20_SLINK=y
CONFIG_PTP_1588_CLOCK=y
CONFIG_GPIO_SYSFS=y
CONFIG_GPIO_TPS65910=y
CONFIG_BATTERY_CHARGER_SURFACE_RT=y
CONFIG_SENSORS_LM90=y
CONFIG_SENSORS_LM95245=y
CONFIG_THERMAL=y
CONFIG_THERMAL_STATISTICS=y
CONFIG_CPU_THERMAL=y
CONFIG_DEVFREQ_THERMAL=y
CONFIG_TEGRA_SOCTHERM=y
CONFIG_TEGRA30_TSENSOR=y
CONFIG_WATCHDOG=y
CONFIG_TEGRA_WATCHDOG=y
CONFIG_MFD_TPS65090=y
CONFIG_MFD_TPS65910=y
CONFIG_REGULATOR=y
CONFIG_REGULATOR_FIXED_VOLTAGE=y
CONFIG_REGULATOR_GPIO=y
CONFIG_REGULATOR_TPS62360=y
CONFIG_REGULATOR_TPS65090=y
CONFIG_REGULATOR_TPS65910=y
CONFIG_MEDIA_SUPPORT=y
CONFIG_DVB_NET=n
CONFIG_DVB_DYNAMIC_MINORS=n
CONFIG_MEDIA_USB_SUPPORT=y
CONFIG_USB_VIDEO_CLASS=y
CONFIG_RADIO_ADAPTERS=n
CONFIG_V4L_MEM2MEM_DRIVERS=y
CONFIG_VIDEO_TEGRA_VDE=y
CONFIG_CXD2880_SPI_DRV=n
CONFIG_MEDIA_TUNER_SIMPLE=n
CONFIG_MEDIA_TUNER_TDA18250=n
CONFIG_MEDIA_TUNER_TDA8290=n
CONFIG_MEDIA_TUNER_TDA827X=n
CONFIG_MEDIA_TUNER_TDA18271=n
CONFIG_MEDIA_TUNER_TDA9887=n
CONFIG_MEDIA_TUNER_TEA5761=n
CONFIG_MEDIA_TUNER_TEA5767=n
CONFIG_MEDIA_TUNER_MSI001=n
CONFIG_MEDIA_TUNER_MT20XX=n
CONFIG_MEDIA_TUNER_MT2060=n
CONFIG_MEDIA_TUNER_MT2063=n
CONFIG_MEDIA_TUNER_MT2266=n
CONFIG_MEDIA_TUNER_MT2131=n
CONFIG_MEDIA_TUNER_QT1010=n
CONFIG_MEDIA_TUNER_XC2028=n
CONFIG_MEDIA_TUNER_XC5000=n
CONFIG_MEDIA_TUNER_XC4000=n
CONFIG_MEDIA_TUNER_MXL5005S=n
CONFIG_MEDIA_TUNER_MXL5007T=n
CONFIG_MEDIA_TUNER_MC44S803=n
CONFIG_MEDIA_TUNER_MAX2165=n
CONFIG_MEDIA_TUNER_TDA18218=n
CONFIG_MEDIA_TUNER_FC0011=n
CONFIG_MEDIA_TUNER_FC0012=n
CONFIG_MEDIA_TUNER_FC0013=n
CONFIG_MEDIA_TUNER_TDA18212=n
CONFIG_MEDIA_TUNER_E4000=n
CONFIG_MEDIA_TUNER_FC2580=n
CONFIG_MEDIA_TUNER_M88RS6000T=n
CONFIG_MEDIA_TUNER_TUA9001=n
CONFIG_MEDIA_TUNER_SI2157=n
CONFIG_MEDIA_TUNER_IT913X=n
CONFIG_MEDIA_TUNER_R820T=n
CONFIG_MEDIA_TUNER_MXL301RF=n
CONFIG_MEDIA_TUNER_QM1D1C0042=n
CONFIG_MEDIA_TUNER_QM1D1B0004=n
CONFIG_DVB_STB0899=n
CONFIG_DVB_STB6100=n
CONFIG_DVB_STV090x=n
CONFIG_DVB_STV0910=n
CONFIG_DVB_STV6110x=n
CONFIG_DVB_STV6111=n
CONFIG_DVB_MXL5XX=n
CONFIG_DVB_M88DS3103=n
CONFIG_DVB_DRXK=n
CONFIG_DVB_TDA18271C2DD=n
CONFIG_DVB_SI2165=n
CONFIG_DVB_MN88472=n
CONFIG_DVB_MN88473=n
CONFIG_DVB_CX24110=n
CONFIG_DVB_CX24123=n
CONFIG_DVB_MT312=n
CONFIG_DVB_ZL10036=n
CONFIG_DVB_ZL10039=n
CONFIG_DVB_S5H1420=n
CONFIG_DVB_STV0288=n
CONFIG_DVB_STB6000=n
CONFIG_DVB_STV0299=n
CONFIG_DVB_STV6110=n
CONFIG_DVB_STV0900=n
CONFIG_DVB_TDA8083=n
CONFIG_DVB_TDA10086=n
CONFIG_DVB_TDA8261=n
CONFIG_DVB_VES1X93=n
CONFIG_DVB_TUNER_ITD1000=n
CONFIG_DVB_TUNER_CX24113=n
CONFIG_DVB_TDA826X=n
CONFIG_DVB_TUA6100=n
CONFIG_DVB_CX24116=n
CONFIG_DVB_CX24117=n
CONFIG_DVB_CX24120=n
CONFIG_DVB_SI21XX=n
CONFIG_DVB_TS2020=n
CONFIG_DVB_DS3000=n
CONFIG_DVB_MB86A16=n
CONFIG_DVB_TDA10071=n
CONFIG_DVB_SP887X=n
CONFIG_DVB_CX22700=n
CONFIG_DVB_CX22702=n
CONFIG_DVB_S5H1432=n
CONFIG_DVB_DRXD=n
CONFIG_DVB_L64781=n
CONFIG_DVB_TDA1004X=n
CONFIG_DVB_NXT6000=n
CONFIG_DVB_MT352=n
CONFIG_DVB_ZL10353=n
CONFIG_DVB_DIB3000MB=n
CONFIG_DVB_DIB3000MC=n
CONFIG_DVB_DIB7000M=n
CONFIG_DVB_DIB7000P=n
CONFIG_DVB_DIB9000=n
CONFIG_DVB_TDA10048=n
CONFIG_DVB_AF9013=n
CONFIG_DVB_EC100=n
CONFIG_DVB_STV0367=n
CONFIG_DVB_CXD2820R=n
CONFIG_DVB_CXD2841ER=n
CONFIG_DVB_RTL2830=n
CONFIG_DVB_RTL2832=n
CONFIG_DVB_RTL2832_SDR=n
CONFIG_DVB_SI2168=n
CONFIG_DVB_ZD1301_DEMOD=n
CONFIG_DVB_CXD2880=n
CONFIG_DVB_VES1820=n
CONFIG_DVB_TDA10021=n
CONFIG_DVB_TDA10023=n
CONFIG_DVB_STV0297=n
CONFIG_DVB_NXT200X=n
CONFIG_DVB_OR51211=n
CONFIG_DVB_OR51132=n
CONFIG_DVB_BCM3510=n
CONFIG_DVB_LGDT330X=n
CONFIG_DVB_LGDT3305=n
CONFIG_DVB_LGDT3306A=n
CONFIG_DVB_LG2160=n
CONFIG_DVB_S5H1409=n
CONFIG_DVB_AU8522_DTV=n
CONFIG_DVB_AU8522_V4L=n
CONFIG_DVB_S5H1411=n
CONFIG_DVB_MXL692=n
CONFIG_DVB_S921=n
CONFIG_DVB_DIB8000=n
CONFIG_DVB_MB86A20S=n
CONFIG_DVB_TC90522=n
CONFIG_DVB_MN88443X=n
CONFIG_DVB_PLL=n
CONFIG_DVB_TUNER_DIB0070=n
CONFIG_DVB_TUNER_DIB0090=n
CONFIG_DVB_DRX39XYJ=n
CONFIG_DVB_LNBH25=n
CONFIG_DVB_LNBH29=n
CONFIG_DVB_LNBP21=n
CONFIG_DVB_LNBP22=n
CONFIG_DVB_ISL6405=n
CONFIG_DVB_ISL6421=n
CONFIG_DVB_ISL6423=n
CONFIG_DVB_A8293=n
CONFIG_DVB_LGS8GL5=n
CONFIG_DVB_LGS8GXX=n
CONFIG_DVB_ATBM8830=n
CONFIG_DVB_TDA665x=n
CONFIG_DVB_IX2505V=n
CONFIG_DVB_M88RS2000=n
CONFIG_DVB_AF9033=n
CONFIG_DVB_HORUS3A=n
CONFIG_DVB_ASCOT2E=n
CONFIG_DVB_HELENE=n
CONFIG_DVB_CXD2099=n
CONFIG_DVB_SP2=n
CONFIG_DRM=y
CONFIG_DRM_TEGRA=y
CONFIG_DRM_PANEL_LVDS=y
CONFIG_DRM_PANEL_SIMPLE=y
CONFIG_DRM_LVDS_CODEC=y
CONFIG_FB=y
CONFIG_BACKLIGHT_CLASS_DEVICE=y
CONFIG_BACKLIGHT_PWM=y
CONFIG_FRAMEBUFFER_CONSOLE=y
CONFIG_FRAMEBUFFER_CONSOLE_ROTATION=y
CONFIG_LOGO=y
CONFIG_SOUND=y
CONFIG_SND=y
CONFIG_SND_SUPPORT_OLD_API=n
CONFIG_SND_DRIVERS=n
CONFIG_SND_HDA_TEGRA=y
CONFIG_SND_HDA_INPUT_BEEP=y
CONFIG_SND_HDA_PATCH_LOADER=y
CONFIG_SND_HDA_CODEC_HDMI=y
CONFIG_SND_HDA_GENERIC=y
CONFIG_SND_ARM=n
CONFIG_SND_SPI=n
CONFIG_SND_USB=n
CONFIG_SND_SOC=y
CONFIG_SND_SOC_TEGRA=y
CONFIG_SND_SOC_TEGRA20_AC97=y
CONFIG_SND_SOC_TEGRA20_I2S=y
CONFIG_SND_SOC_TEGRA20_SPDIF=y
CONFIG_SND_SOC_TEGRA30_I2S=y
CONFIG_SND_SOC_TEGRA_WM8962=y
CONFIG_HID_MICROSOFT=y
CONFIG_HID_SENSOR_HUB=y
CONFIG_I2C_HID_OF=y
CONFIG_USB=y
CONFIG_USB_XHCI_HCD=y
CONFIG_USB_XHCI_TEGRA=y
CONFIG_USB_EHCI_HCD=y
CONFIG_USB_ACM=y
CONFIG_USB_WDM=y
CONFIG_USB_STORAGE=y
CONFIG_USB_CHIPIDEA=y
CONFIG_USB_CHIPIDEA_UDC=y
CONFIG_USB_CHIPIDEA_HOST=y
CONFIG_USB_SERIAL=y
CONFIG_USB_SERIAL_CH341=y
CONFIG_USB_GADGET=y
CONFIG_U_SERIAL_CONSOLE=y
CONFIG_USB_CONFIGFS=y
CONFIG_USB_CONFIGFS_MASS_STORAGE=y
CONFIG_USB_MASS_STORAGE=m
CONFIG_USB_G_SERIAL=m
CONFIG_USB_G_ACM_MS=m
CONFIG_MMC=y
CONFIG_MMC_BLOCK_MINORS=16
CONFIG_MMC_SDHCI=y
CONFIG_MMC_SDHCI_PLTFM=y
CONFIG_MMC_SDHCI_TEGRA=y
CONFIG_RTC_CLASS=y
CONFIG_RTC_DRV_TPS65910=y
CONFIG_RTC_DRV_TEGRA=y
CONFIG_DMADEVICES=y
CONFIG_TEGRA20_APB_DMA=y
CONFIG_VIRTIO_MENU=n
CONFIG_VHOST_MENU=n
CONFIG_TEGRA_IOMMU_SMMU=y
CONFIG_ARCH_TEGRA_3x_SOC=y
CONFIG_PM_DEVFREQ=y
CONFIG_DEVFREQ_GOV_SIMPLE_ONDEMAND=y
CONFIG_ARM_TEGRA_DEVFREQ=y
CONFIG_MEMORY=y
CONFIG_IIO=y
CONFIG_HID_SENSOR_ACCEL_3D=y
CONFIG_HID_SENSOR_GYRO_3D=y
CONFIG_HID_SENSOR_ALS=y
CONFIG_HID_SENSOR_MAGNETOMETER_3D=y
CONFIG_HID_SENSOR_INCLINOMETER_3D=y
CONFIG_HID_SENSOR_DEVICE_ROTATION=y
CONFIG_PWM=y
CONFIG_PWM_TEGRA=y
CONFIG_PHY_TEGRA_XUSB=y
CONFIG_EXT2_FS=y
CONFIG_EXT2_FS_XATTR=y
CONFIG_EXT2_FS_POSIX_ACL=y
CONFIG_EXT2_FS_SECURITY=y
CONFIG_EXT3_FS=y
CONFIG_EXT3_FS_POSIX_ACL=y
CONFIG_EXT3_FS_SECURITY=y
CONFIG_DNOTIFY=n
CONFIG_VFAT_FS=y
CONFIG_NTFS_FS=y
CONFIG_NTFS_RW=y
CONFIG_NTFS3_FS=y
CONFIG_TMPFS=y
CONFIG_TMPFS_POSIX_ACL=y
CONFIG_EFIVAR_FS=y
CONFIG_PSTORE=y
CONFIG_PSTORE_LZO_COMPRESS=y
CONFIG_PSTORE_LZ4_COMPRESS=y
CONFIG_PSTORE_LZ4HC_COMPRESS=y
CONFIG_PSTORE_842_COMPRESS=y
CONFIG_PSTORE_CONSOLE=y
CONFIG_PSTORE_RAM=y
CONFIG_NFS_FS=y
CONFIG_NFS_V4=y
CONFIG_ROOT_NFS=y
CONFIG_NLS_CODEPAGE_437=y
CONFIG_NLS_ISO8859_1=y
CONFIG_CRYPTO_TWOFISH=y
CONFIG_DMA_CMA=y
CONFIG_CMA_SIZE_MBYTES=64
CONFIG_PRINTK_TIME=y
CONFIG_MAGIC_SYSRQ=y
CONFIG_DEBUG_SLAB=y
CONFIG_DEBUG_VM=y
CONFIG_DETECT_HUNG_TASK=y
CONFIG_SCHEDSTATS=y
CONFIG_DEBUG_PREEMPT=n
CONFIG_DEBUG_MUTEXES=y
CONFIG_DEBUG_SG=y
CONFIG_DEBUG_LL=y
CONFIG_TEGRA_DEBUG_UARTA=y
CONFIG_DEBUG_UNCOMPRESS=y
CONFIG_EARLY_PRINTK=y
```
